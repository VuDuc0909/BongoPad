#include <Adafruit_SH110X.h>
#include <Adafruit_NeoPixel.h>
#include <RotaryEncoder.h>
#include <Wire.h>
#include "Adafruit_NeoKey_1x4.h"
#include "seesaw_neopixel.h"
#include "Keyboard.h"

Adafruit_NeoKey_1x4 neokey;

// Create the OLED display
Adafruit_SH1106G display = Adafruit_SH1106G(128, 64, &SPI1, OLED_DC, OLED_RST, OLED_CS);

// Create the neopixel strip with the built in definitions NUM_NEOPIXEL and PIN_NEOPIXEL
Adafruit_NeoPixel pixels = Adafruit_NeoPixel(NUM_NEOPIXEL, PIN_NEOPIXEL, NEO_GRB + NEO_KHZ800);

// bongo cat frame
const unsigned char PROGMEM cat_frame0 [] = {0xFF, 0xFF, 0xFF, 0xFF, 0xFF, 0xFF, 0xFF, 0xFF, 0xFF, 0xFF, 0xFF, 0xFF, 0xFF,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 0xFF, 0xFF};
const unsigned char PROGMEM cat_frame1 [] = {0xFF, 0xFF, 0xFF, 0xFF, 0xFF, 0xFF, 0xFF, 0xFF, 0xFF, 0xFF, 0xFF, 0xFF, 0xFF,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 0xFF, 0xFF};
const unsigned char PROGMEM cat_frame2 [] = {0xFF, 0xFF, 0xFF, 0xFF, 0xFF, 0xFF, 0xFF, 0xFF, 0xFF, 0xFF, 0xFF, 0xFF, 0xFF,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 0xFF, 0xFF};
const unsigned char PROGMEM cat_frame3 [] = {0xFF, 0xFF, 0xFF, 0xFF, 0xFF, 0xFF, 0xFF, 0xFF, 0xFF, 0xFF, 0xFF, 0xFF, 0xFF,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 0xFF, 0xFF};
const unsigned char PROGMEM cat_frame4 [] = {0xFF, 0xFF, 0xFF, 0xFF, 0xFF, 0xFF, 0xFF, 0xFF, 0xFF, 0xFF, 0xFF, 0xFF, 0xFF,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 0xFF, 0xFF};

// keyboard layout
int layout[16] = {0xE1, 0xE2, 0xE3, 0xE4, 0xE5, 0xE6, 0xE7, 0xE8, 0xE9, 0x85, 0xEA, 0xB2, 0xDF, 0xDE, 0xDD, 0xDC};

void setup() {

  Serial.begin(115200);
  //while (!Serial) { delay(10); }     // wait till serial port is opened
  Keyboard.begin();
  delay(100);  // RP2040 delay is not a bad idea

  // start pixels!
  pixels.begin();
  pixels.setBrightness(255);
  pixels.show(); // Initialize all pixels to 'off'

  // set all mechanical keys to inputs
  for (uint8_t i=0; i<=12; ++i) 
    pinMode(i, INPUT_PULLUP);

  // Start i2c connect of Adafruit neokey 1x4
  neokey.begin(0x30);

  // set up neokey pixel
  for (uint16_t i=0; i<neokey.pixels.numPixels(); ++i) {
    neokey.pixels.setPixelColor(i, Wheel(map(i, 0, neokey.pixels.numPixels(), 0, 255)));
    neokey.pixels.show();
    delay(50);
  }
  for (uint16_t i=0; i<neokey.pixels.numPixels(); ++i) {
    neokey.pixels.setPixelColor(i, 0x000000);
    neokey.pixels.show();
    delay(150);
  }

}

// global var to control RGB neopixel led
uint8_t j = 0;
  
void loop() {
  // macropad key press and release act as keyboard key
  Keyboard.begin();
  for (int i=1; i<=12; i++) {
    if (!digitalRead(i) ) {
      Keyboard.press(layout[i-1]);
      if(i == 1 || i == 4 || i == 7 || i == 10)
        rp2040.fifo.push_nb(1);   // push data to other core
      else
        rp2040.fifo.push_nb(2);          
    } else {
      Keyboard.release(layout[i-1]);
    }
  }

  // neokey press and release act as keyboard key
  uint8_t buttons = neokey.read();
  if (buttons & (1<<0)) {
    Keyboard.press(layout[12]);
    rp2040.fifo.push_nb(1); 
  }   
  else
    Keyboard.release(layout[12]);  
  if (buttons & (1<<1)) {
    Keyboard.press(layout[13]);
    rp2040.fifo.push_nb(1);
  }
  else
    Keyboard.release(layout[13]); 
  if (buttons & (1<<2)) {
    Keyboard.press(layout[14]);
    rp2040.fifo.push_nb(1);
  }
  else
    Keyboard.release(layout[14]); 
  if (buttons & (1<<3)) {
    Keyboard.press(layout[15]);
    rp2040.fifo.push_nb(1);
  }
  else
    Keyboard.release(layout[15]);      
      
  // RGB efffect of macropad neopixel nad neokey neopixel
  for(int i=0; i< pixels.numPixels(); ++i) 
    pixels.setPixelColor(i, Wheel(((i * 256 / pixels.numPixels()) + j) & 255));
  for (int i=neokey.pixels.numPixels()-1; i >= 0; --i) 
    neokey.pixels.setPixelColor(i, Wheel(((i * 256 / neokey.pixels.numPixels()) + j+3) & 255));      
            
  // show neopixels, incredment swirl
  neokey.pixels.show();
  pixels.show();
  j++;

}

// Input a value 0 to 255 to get a color value.
// The colours are a transition r - g - b - back to r.
uint32_t Wheel(byte WheelPos) {
  if(WheelPos < 85) 
    return pixels.Color(255 - WheelPos * 3, 0, WheelPos * 3);
  else if(WheelPos < 170) {
    WheelPos -= 85;
    return pixels.Color(0, WheelPos * 3, 255 - WheelPos * 3);
  } else {
    WheelPos -= 170;
    return pixels.Color(WheelPos * 3, 255 - WheelPos * 3, 0);
  }
}

// core 1: Process images to output to oled display
int oled_state = 1; // state of the oled display
int millisecond = 0; // counter to display oled

void setup1() {
  Serial.begin(115200);
  delay(100);  
  
  // Start OLED
  display.begin(0, true); // we dont use the i2c address but we will reset!
  display.display();
  display.invertDisplay(true);
  display.drawBitmap(0, 0,cat_frame0,128,64, 1);
  display.display();
}

void loop1() {
  uint32_t dest = 0;
  // read data from other core (keyboard state)
  if(rp2040.fifo.pop_nb(&dest)) {
    delay(50);
    rp2040.fifo.clear();
  } 
  bongo_cat(dest);
}

// process bongo cat gif
void bongo_cat(uint32_t clap) {
  if(clap == 0) {
    if(oled_state == 3 && millisecond >= 100000) {
      display.clearDisplay();
      display.drawBitmap(0, 0,cat_frame0,128,64, 1);
      display.display();
      oled_state = 1;
      millisecond = 0;
    }
    if(oled_state == 1 && millisecond >= 100000) {
      display.clearDisplay();
      display.drawBitmap(0, 0,cat_frame1,128,64, 1);
      display.display();
      oled_state = 2;
      millisecond = 0;
    }  
    if(oled_state == 2 && millisecond >= 100000)  {
      display.clearDisplay();
      display.drawBitmap(0, 0,cat_frame4,128,64, 1);
      display.display();
      oled_state = 3;
      millisecond = 0;
    }    
  }
  else {
    millisecond = 70000;
    if (clap == 1)   {
      display.drawBitmap(0, 0,cat_frame2,128,64, 1);
      display.display();  
    } 
    else if (clap == 2)   {
      display.drawBitmap(0, 0,cat_frame3,128,64, 1);
      display.display();  
    } 
    display.clearDisplay();
  } 
  millisecond++;
}
